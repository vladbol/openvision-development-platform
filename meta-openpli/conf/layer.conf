## meta-openpli/conf/layer.conf
```bitbake
LAYERSERIES_COMPAT_local-layer = "warrior"
LAYERSERIES_COMPAT_meta-python = "warrior"
LAYERSERIES_COMPAT_openembedded-layer = "warrior"
LAYERSERIES_COMPAT_openvision-layer = "warrior"
```
